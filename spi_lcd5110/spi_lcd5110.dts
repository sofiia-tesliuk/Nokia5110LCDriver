/dts-v1/;
/plugin/;

/ {
    compatible = "lcd5110,spi_lcd5110";

    /* disable spi-dev for spi0.0 */

    fragment@0 {
        target = <&spidev0>;
        __overlay__ {
        status = "disabled";
      };
    };

    fragment@1 {
        target = <&spi0>;
        __overlay__ {
            status = "okay";
            #address-cells = <1>;
            #size-cells = <0>;

            spi_lcd5110: spi_lcd5110@0 {
                reg = <0>; /* CE0 */
                compatible = "lcd5110,spi_lcd5110";
                spi-max-frequency = <3500000>; // 3.5MHz
                status = "okay";
            };
        };
    };
};
